## boards/shields/SofleCirque/Kconfig.defconfig
```kconfig
if SHIELD_SofleCirque_LEFT

# Name must be less than 16 characters long!
config ZMK_KEYBOARD_NAME
    default "My Keyboard"

config ZMK_SPLIT_ROLE_CENTRAL
    default y

config ZMK_POINTING
    default y

config I2C
    default y

endif

if SHIELD_SofleCirque_LEFT || SHIELD_SofleCirque_RIGHT

config ZMK_SPLIT
    default y

endif
```

## boards/shields/SofleCirque/Kconfig.shield
```kconfig
# No whitespace after the comma or in your part name!
config SHIELD_SofleCirque_LEFT
    def_bool $(shields_list_contains,SofleCirque_left)

# No whitespace after the comma or in your part name!
config SHIELD_SofleCirque_RIGHT
    def_bool $(shields_list_contains,SofleCirque_right)
```
